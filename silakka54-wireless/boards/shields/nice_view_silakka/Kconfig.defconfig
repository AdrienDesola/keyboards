## silakka54-wireless/boards/shields/nice_view_silakka/Kconfig.defconfig
```kconfig
# nice!view with a custom status screen: battery, active Bluetooth profile with
# its host name, layer, and a themed stage on each half (themes/<name>/).

if SHIELD_NICE_VIEW_SILAKKA

config LV_Z_VDB_SIZE
    default 100

config LV_DPI_DEF
    default 161

config LV_Z_BITS_PER_PIXEL
    default 1

choice LV_COLOR_DEPTH
    default LV_COLOR_DEPTH_1
endchoice

choice ZMK_DISPLAY_WORK_QUEUE
    default ZMK_DISPLAY_WORK_QUEUE_DEDICATED
endchoice

choice ZMK_DISPLAY_STATUS_SCREEN
    default ZMK_DISPLAY_STATUS_SCREEN_CUSTOM
endchoice

config LV_Z_MEM_POOL_SIZE
    default 4096 if ZMK_DISPLAY_STATUS_SCREEN_CUSTOM

config ZMK_DISPLAY_STATUS_SCREEN_CUSTOM
    imply NICE_VIEW_SILAKKA_WIDGET_STATUS

config NICE_VIEW_SILAKKA_WIDGET_STATUS
    bool "Silakka54 nice!view status widget"
    select LV_FONT_MONTSERRAT_16
    select LV_USE_IMG
    select LV_USE_CANVAS

config NICE_VIEW_SILAKKA_WIDGET_INVERTED
    bool "Invert status widget colors"

config NICE_VIEW_SILAKKA_PROFILE_NAMES
    string "Names for Bluetooth profiles 1-5, comma separated"
    default ""

config NICE_VIEW_SILAKKA_THEME
    string "Theme folder under themes/; only its files for this half are built"
    default "jack"

config NICE_VIEW_SILAKKA_ART_BLINK_MS
    int "Stage: blink period while that half is being typed on, in ms (0 = never)"
    default 2000

config NICE_VIEW_SILAKKA_ART_IDLE_MS
    int "Stage: period of the idle move (awake: blink + bat flap, asleep: Zs drift), in ms (0 = never)"
    default 120000

config NICE_VIEW_SILAKKA_NAME_SCROLL_MS
    int "Scroll step for a host name wider than the screen, in ms (0 = truncate instead)"
    default 150

if !ZMK_SPLIT || ZMK_SPLIT_ROLE_CENTRAL

config NICE_VIEW_SILAKKA_WIDGET_STATUS
    select LV_FONT_MONTSERRAT_18
    select LV_FONT_MONTSERRAT_14
    select LV_FONT_UNSCII_8

endif # !ZMK_SPLIT || ZMK_SPLIT_ROLE_CENTRAL

config ZMK_DISPLAY_STATUS_SCREEN_BUILT_IN
    select LV_FONT_MONTSERRAT_26

endif # SHIELD_NICE_VIEW_SILAKKA
```

## silakka54-wireless/boards/shields/nice_view_silakka/Kconfig.shield
```kconfig
config SHIELD_NICE_VIEW_SILAKKA
    def_bool $(shields_list_contains,nice_view_silakka)
```
